## board/atmel/sama5d2_avatar/Kconfig
```kconfig
if TARGET_SAMA5D2_AVATAR

config SYS_BOARD
	default "sama5d2_avatar"

config SYS_VENDOR
	default "atmel"

config SYS_SOC
	default "at91"

config SYS_CONFIG_NAME
	default "sama5d2_avatar"

endif
```
